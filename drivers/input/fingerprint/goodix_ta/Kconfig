## drivers/input/fingerprint/goodix_ta/Kconfig
```kconfig
config FINGERPRINT_GOODIX_TA
	tristate "Finger print card goodix"
	depends on INPUT_FINGERPRINT
	help
	  Say Y here to enable support for retrieving self-test reports.
	  To compile this driver as a module, choose M here.
	  If unsure, say N.
```

## drivers/input/touchscreen/goodix_driver_gt9886/Kconfig
```kconfig
# Goodix touchscreen driver configuration

menuconfig TOUCHSCREEN_GOODIX_GTX8
	bool "Goodix GTx8 touchscreen"
	depends on I2C
	help
	  Say Y here if you have a Goodix GTx5xx touchscreen connected
	  to your system.

	  If unsure, say N.

if TOUCHSCREEN_GOODIX_GTX8

config TOUCHSCREEN_GOODIX_GTX8_UPDATE
	tristate "Goodix GTx8 firmware update module"
	default y
	help
	  Say Y here to enable support for doing firmware update.
	  To compile this driver as a module, choose M here.
	  If unsure, say N.

config TOUCHSCREEN_GOODIX_GTX8_GESTURE
	tristate "Goodix GTx8 gesture wakeup feature"
	default y
	help
	  Say Y here to enable support for gesture wakeup feature..
	  To compile this driver as a module, choose M here.
	  If unsure, say N.

endif
```
